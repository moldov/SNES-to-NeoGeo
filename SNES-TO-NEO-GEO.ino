/*
SNES to NEO-GEO Arduino adapter which has been used during consolizing MV1B
based on Robin Edwards code found at 
https://github.com/robinhedwards/SNES-to-NeoGeo
https://github.com/burks10/Arduino-SNES-Controller
*/

/* Button combinations
 * SELECT + START - Pause mode (DIP_SWITCH 8) - Disabled after UNIBIOS installation
 * SELECT + A + X - Test mode (DIP_SWITCH 1)
 * SELECT + B + Y - Freeplay mode (DIP_SWITCH 7)
 * L_SHIFT and START - I made them equal because if you use 8Bitdo and holding start more than 5sec 
 * contoller being powered down, so I dublicated START to L_SHIFT. It allows to reset console if  
 * You play famous Banana 161 in 1 chineese game cartridge by holding L_SHIFT about 5~10 seconds
 * SELECT + any of A, B, X OR Y - Autofire mode - switch on/off them in autofire mode
 */


#include <SPI.h>
#include <Wire.h>
#include <Adafruit_GFX.h>
#include <Adafruit_SSD1306.h>

#define OLED_RESET 4
Adafruit_SSD1306 display(OLED_RESET);

/* 
SNES Controller -> Arduino
  -----------------\
  | 1 2 3 4 | 5 6 7 |
  -----------------/
  
  Pin 1: +5V
  Pin 2: Clock -> Arduino A0
  Pin 3: Latch -> Arduino A1
  Pin 4: Serial -> Arduino A2
  Pin 7: GND
*/

int DATA_CLOCK    = A0;
int DATA_LATCH    = A1;
int DATA_SERIAL   = A2;

/* 
Arduino -> DB15
    1(=GND)        8(=5V)
  \-------------------/
   \ o o o o o o o o / [Viewed from front]
    \ o o o o o o o /
     --------------- 
      9          15
 DB15 Pin  ->  Arduino
 --------      -------
 1 (GND)       GND
 8 (+5V)       +5V
 3 (Sel)       D2
 11 (Start)    D3
 15 (Up)       D4
 7 (Down)      D5
 14 (Left)     D6
 6 (Right)     D7
 13 (A)        D8
 5 (B)         D9
 12 (C)        D10
 4 (D)         D11
*/

#define PIN_SELECT   2
#define PIN_START    3

#define PIN_UP       4
#define PIN_DOWN     5
#define PIN_LEFT     6
#define PIN_RIGHT    7

#define PIN_BUT_A    8
#define PIN_BUT_B    9
#define PIN_BUT_Y    10
#define PIN_BUT_X    11

#define PIN_LED      13

#define PIN_TEST     13
#define PIN_FREE     A3
#define PIN_PAUSE    12


#define BUT_A         8
#define BUT_B         0
#define BUT_X         9
#define BUT_Y         1

#define BUT_SELECT    2
#define BUT_START     3

#define BUT_LS        10
#define BUT_RS        11

#define TEST_STATE    0
#define FREE_STATE    1
#define PAUSE_STATE   2

#define TURBO_A       0
#define TURBO_B       1
#define TURBO_X       2
#define TURBO_Y       3

/* = SNK Logo = */
/* = S Letter = */
const unsigned char PROGMEM logoBmp_s[] = {
0x00, 0x00, 0x00, 0x00, 0x00, 0x00, 0x00, 0x00, 0x00, 0x00, 0x00, 0x00, 0x00, 0x00, 0x00, 0x00, 
0x00, 0x00, 0x00, 0x00, 0x00, 0x00, 0x00, 0x00, 0x00, 0x00, 0x00, 0x00, 0x00, 0x00, 0x00, 0x00, 
0x00, 0x00, 0x00, 0x00, 0x00, 0x00, 0x00, 0x00, 0x00, 0x00, 0x00, 0x00, 0x00, 0x00, 0x00, 0x00, 
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0x00, 0x00, 0x00, 0x00, 0x00, 0x00, 0x00, 0x00, 0x00, 0x00, 0x00, 0x00, 0x00, 0x00, 0x00, 0x00, 
0
};

/* = N Letter = */
const unsigned char PROGMEM logoBmp_sn[] = {
  0x00, 0x00, 0x00, 0x00, 0x00, 0x00, 0x00, 0x00, 0x00, 0x00, 0x00, 0x00, 0x00, 0x00, 0x00, 0x00, 
0x00, 0x00, 0x00, 0x00, 0x00, 0x00, 0x00, 0x00, 0x00, 0x00, 0x00, 0x00, 0x00, 0x00, 0x00, 0x00, 
0x00, 0x00, 0x00, 0x00, 0x00, 0x00, 0x00, 0x00, 0x00, 0x00, 0x00, 0x00, 0x00, 0x00, 0x00, 0x00, 
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0x00, 0x00, 0x00, 0x00, 0x00, 0x00, 0x00, 0x00, 0x00, 0x00, 0x00, 0x00, 0x00, 0x00, 0x00, 0x00, 
0
};

/* = K Letter = */
const unsigned char PROGMEM logoBmp_snk[] = {
0x00, 0x00, 0x00, 0x00, 0x00, 0x00, 0x00, 0x00, 0x00, 0x00, 0x00, 0x00, 0x00, 0x00, 0x00, 0x00, 
0x00, 0x00, 0x00, 0x00, 0x00, 0x00, 0x00, 0x00, 0x00, 0x00, 0x00, 0x00, 0x00, 0x00, 0x00, 0x00, 
0x00, 0x00, 0x00, 0x00, 0x00, 0x00, 0x00, 0x00, 0x00, 0x00, 0x00, 0x00, 0x00, 0x00, 0x00, 0x00, 
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0x00, 0x00, 0x00, 0x00, 0x00, 0x00, 0x00, 0x00, 0x00, 0x00, 0x00, 0x00, 0x00, 0x00, 0x00, 0x00, 
0
};

int buttons_state[12];  // B,Y,Sel,Start,U,D,L,R,A,X,L,R
int is_pressed[12];
int output_pins[12] = { PIN_BUT_B, PIN_BUT_Y, PIN_SELECT, PIN_START, PIN_UP, PIN_DOWN,
                        PIN_LEFT, PIN_RIGHT, PIN_BUT_A, PIN_BUT_X, 0, 0 };

unsigned long time_global = millis(); 

char dips[] = "____";
char turbo[] = "____";

void setup ()
{
    pinMode(DATA_CLOCK, OUTPUT);
    digitalWrite (DATA_CLOCK, HIGH);
  
    pinMode(DATA_LATCH, OUTPUT);
    digitalWrite(DATA_LATCH, LOW);
    
    pinMode(DATA_SERIAL, INPUT_PULLUP);
    
    pinMode(PIN_LED, OUTPUT);
   
    pinMode(PIN_PAUSE, OUTPUT);
    pinMode(PIN_TEST, OUTPUT);
    pinMode(PIN_FREE, OUTPUT);

    digitalWrite(PIN_PAUSE, HIGH);
    digitalWrite(PIN_TEST, HIGH);
    digitalWrite(PIN_FREE, HIGH);

    display.begin(SSD1306_SWITCHCAPVCC, 0x3C);
    display.clearDisplay();
    display.drawBitmap(0, 0, logoBmp_s, 128, 64, WHITE);
    display.display();
    delay(1000);
    display.drawBitmap(0, 0, logoBmp_sn, 128, 64, WHITE);
    display.display();
    delay(1000);
    display.drawBitmap(0, 0, logoBmp_snk, 128, 64, WHITE);
    display.display();
    delay(5000);
}

void loop ()
{
    // Read from the SNES controller
    
    /* Latch for 12us */
    digitalWrite(DATA_LATCH, HIGH);
    delayMicroseconds(12);
    digitalWrite(DATA_LATCH, LOW);
    delayMicroseconds(6);
    
    /* Read data bit by bit from SR */
    for (int i = 0; i < 16; i++) {
        digitalWrite(DATA_CLOCK, LOW);
        delayMicroseconds(6);
        if (i <= 11)
            buttons_state[i] = digitalRead(DATA_SERIAL);
        digitalWrite(DATA_CLOCK, HIGH);
        delayMicroseconds(6);
    }
    
    // Output the state on our DB15 output pins
    // pulling them low if the equivalent SNES button
    // is pushed
    for (int i = 0; i <= 11; i++)
    {
        if (output_pins[i] != 0)
        {
            if (!buttons_state[i]  )
            {
               if (!buttons_state[BUT_A] && turbo[TURBO_A] != '_' && is_pressed[BUT_A] == 0 ) {
                        tone(output_pins[PIN_BUT_A], 10);
                        is_pressed[BUT_A] = 1;
               }
               if (!buttons_state[BUT_B] && turbo[TURBO_B] != '_' && is_pressed[BUT_B] == 0 ) {
                        tone(output_pins[BUT_B], 10);
                        is_pressed[BUT_B] = 1;
               }


               if (!buttons_state[BUT_X] && turbo[TURBO_X] != '_' && is_pressed[BUT_X] == 0 ) {
                        tone(output_pins[BUT_X], 10);
                        is_pressed[BUT_X] = 1;
               }

               if (!buttons_state[BUT_Y] && turbo[TURBO_Y] != '_' && is_pressed[BUT_Y] == 0 ) {
                        tone(output_pins[BUT_Y], 10);
                        is_pressed[BUT_Y] = 1;
               }
               
               digitalWrite(output_pins[i], LOW);
               pinMode(output_pins[i], OUTPUT);
            }
            else {
               /*Fixing the issue because Start in 8Bitdo acts as Switch off button and 
               in 161 in 1 it works as reset. So I dublicated Left Shift to act as Start
               */
                if (!buttons_state[BUT_LS] || !buttons_state[BUT_START]) {
                    digitalWrite(output_pins[PIN_START], LOW);
                    pinMode(output_pins[PIN_START], OUTPUT);
                }
                pinMode(output_pins[i], INPUT); 
                noTone(output_pins[i]);
                is_pressed[i] = 0;
            }      
        }
    }


/* SELECT + START act as Pause mode DISABLED after UNIBIOS installation
    if (!buttons_state[BUT_SELECT] && !buttons_state[BUT_START]) {
      if ( millis() - time_global >= 100) { //delay added because of contact bounce
      if ( dips[PAUSE_STATE] == 'P' ) {
          digitalWrite(PIN_PAUSE, HIGH);
        }
        else {
          digitalWrite(PIN_PAUSE, LOW);
        }
      }
      time_global = millis();
    }
*/

// Switch on DIPswitch in case of freeplay mode
if (!buttons_state[BUT_B] && !buttons_state[BUT_Y] && !buttons_state[BUT_SELECT])  {
  if ( millis() - time_global >= 500) { //delay added because of contact bounce
        if ( dips[FREE_STATE] == 'F' ) {
          digitalWrite(PIN_FREE, HIGH);
        }
        else {
          digitalWrite(PIN_FREE, LOW);
        }
          time_global = millis();
    } 
}

// Switch on DIPswitch in case of test mode
if (!buttons_state[BUT_SELECT] && !buttons_state[BUT_A] && !buttons_state[BUT_X]) {
    if ( millis() - time_global >= 500) { //delay added because of contact bounce
        if ( dips[TEST_STATE] == 'T' ) {
          digitalWrite(PIN_TEST, HIGH);
        }
        else {
          digitalWrite(PIN_TEST, LOW);
        }
        time_global = millis();
     }
}


//TURBO_BUT_A MODE
if (!buttons_state[BUT_SELECT] && !buttons_state[BUT_A]) {
    if ( millis() - time_global >= 1000) { //delay added because of contact bounce
        if (  turbo[TURBO_A] != '_' ) {
           turbo[TURBO_A] = '_';
           noTone(output_pins[BUT_A]);
        }
        else {
            turbo[TURBO_A] = 'A';
        }
      }
      time_global = millis();
}

//TURBO_BUT_B MODE
if (!buttons_state[BUT_SELECT] && !buttons_state[BUT_B]) {
    if ( millis() - time_global >= 1000) { //delay added because of contact bounce
        if ( turbo[TURBO_B] != '_' ) {
            turbo[TURBO_B] = '_';
            noTone(output_pins[BUT_B]);
        }
        else {
            turbo[TURBO_B] = 'B';
        }
      }
      time_global = millis();
}

//TURBO_BUT_X MODE
if (!buttons_state[BUT_SELECT] && !buttons_state[BUT_X]) {
    if ( millis() - time_global >= 1000) { //delay added because of contact bounce
        if (turbo[TURBO_X] != '_') {
            turbo[TURBO_X] = '_';
            noTone(output_pins[BUT_X]);
        }
        else {
            turbo[TURBO_X] = 'X';
        }
      }
      time_global = millis();
}


//TURBO_BUT_Y MODE
if (!buttons_state[BUT_SELECT] && !buttons_state[BUT_Y]) {
      if ( millis() - time_global >= 1000) { //delay added because of contact bounce
          if (turbo[TURBO_Y] != '_') {
            turbo[TURBO_Y] = '_';
            noTone(output_pins[BUT_Y]);
          }
            else {
            turbo[TURBO_Y] = 'Y';
          }
      }
      time_global = millis();
}

//Show the status of buttons and DIPSwitches on the display

    if ( !digitalRead(PIN_TEST)) {
      dips[TEST_STATE] = 'T';
    }
    else {
      dips[TEST_STATE] = '_';
    } 

    if ( !digitalRead(PIN_FREE)) {
      dips[FREE_STATE] = 'F';
    }
    else {
      dips[FREE_STATE] = '_';
    } 

    if ( !digitalRead(PIN_PAUSE)) {
      dips[PAUSE_STATE] = 'P';
    }
    else {
      dips[PAUSE_STATE] = '_';
    } 
   

    display.clearDisplay();
    display.setTextSize(2);
    display.setTextColor(WHITE);
    display.setCursor(0,5);
    display.println("DIP");
    display.setCursor(0,36);
    display.println("TRB");

    display.setTextSize(3);
    display.setCursor(40,0);

    display.println(dips);
    display.setCursor(40,32);
    display.println(turbo);
    display.display();

    delay(5);
}
